## drivers/pinctrl/sunplus/Kconfig
```kconfig
config PINCTRL_SUNPLUS
	bool "Sunplus SP7021 Pinctrl and GPIO driver"
	depends on DM && ARCH_PENTAGRAM
	select PINCTRL
	select DM_GPIO
	default y
	help
	  Support pin configuration control on Sunplus's SP7021 SoC.

	  The driver is controlled by a device tree node which contains both
	  the GPIO definitions and pin control functions.
```
